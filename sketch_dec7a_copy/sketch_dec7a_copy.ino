#include <Servo.h>

Servo LeftMotor;
Servo RightMotor;

int LSen = 4;
int RSen = 5;
int HyperTrig = 3;
int HyperEcho = 2;

void setup() {
  pinMode(LSen, INPUT);
  pinMode(RSen, INPUT);
  pinMode(HyperTrig, OUTPUT);
  pinMode(HyperEcho, INPUT);
  LeftMotor.attach(7);
  RightMotor.attach(8);
  Serial.begin(9600);
}

void loop() {
  // do all hypersonic "first", it occurs so fast it doesn't matter
  long duration = 0;
  int distance = 0;
  digitalWrite(HyperTrig, LOW);
  delayMicroseconds(2);
  digitalWrite(HyperTrig, HIGH);
  delayMicroseconds(10);
  digitalWrite(HyperTrig, LOW);
  duration = pulseIn(HyperEcho, HIGH);
  distance = (duration/2)/74;
  
  if (distance < 3){ // distance is less than 3 inches
    // reverse 
    LeftMotor.write(0);
    RightMotor.write(180);
    delay(1000); // requires full second to turn
  }
  else{ // distance > 3 inches  
    if (digitalRead(LSen) == HIGH){ // Left Sensor over Black
      if (digitalRead(RSen) == HIGH){ // Right is also Black
        // Full stop
        LeftMotor.write(90);
        RightMotor.write(90);
      }
      else{ // only left is bad
        LeftMotor.write(100);
        RightMotor.write(0);
      }
    }
    else if (digitalRead(RSen) == HIGH){ // Right Sensor over Black
      if (digitalRead(LSen) == HIGH){ // Left is also Black
        LeftMotor.write(90);
        RightMotor.write(90);
      }
      else{ // only right is bad
        LeftMotor.write(180);
        RightMotor.write(80);
      }
    }
    else{ // move normal
      LeftMotor.write(180);
      RightMotor.write(0);
    }
    delay(100);  // every 0.1 secs
  }
}
